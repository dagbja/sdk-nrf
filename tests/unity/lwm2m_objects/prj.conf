## CMakeLists.txt
```
# Copyright (c) 2019 - 2021 Nordic Semiconductor ASA. All Rights Reserved.
#
# The information contained herein is confidential property of Nordic Semiconductor ASA.
# The use, copying, transfer or disclosure of such information is prohibited except by
# express written agreement with Nordic Semiconductor ASA.

cmake_minimum_required(VERSION 3.13.1)

find_package(Zephyr REQUIRED HINTS $ENV{ZEPHYR_BASE})
project(example)

# generate runner for the test
test_runner_generate(src/unity_test.c)

# create mock for dependencies
##cmock_handle(../../../../nrfxlib/nrf_modem/include/nrf_socket.h)

# add necessary includes
target_include_directories(app PRIVATE ../../..)
target_include_directories(app PRIVATE /home/dabj/ncs/lwm2m/lib/lwm2m/include)
target_include_directories(app PRIVATE /home/dabj/ncs/lwm2m/lib/lwm2m/src)
target_include_directories(app PRIVATE /home/dabj/ncs/lwm2m/lib/lwm2m_carrier/src)
target_include_directories(app PRIVATE /home/dabj/ncs/lwm2m/lib/lwm2m_carrier/include)
target_include_directories(app PRIVATE /home/dabj/ncs/lwm2m/lib/coap/include)
target_include_directories(app PRIVATE /home/dabj/ncs/lwm2m/lib/coap/src)

# add test file
target_sources(app PRIVATE src/unity_test.c)
```

## prj.conf
```kconfig
# Copyright (c) 2019 - 2021 Nordic Semiconductor ASA. All Rights Reserved.
#
# The information contained herein is confidential property of Nordic Semiconductor ASA.
# The use, copying, transfer or disclosure of such information is prohibited except by
# express written agreement with Nordic Semiconductor ASA.

CONFIG_UNITY=y
CONFIG_RING_BUFFER=y
CONFIG_LWM2M_CARRIER=y
```

## src/unity_test.c
```c
#define CONFIG_LWM2M_CARRIER

#include <string.h>
#include <stdlib.h>
#include "unity.h"
#include "stddef.h"
#include "lwm2m_objects.h"

#include "lwm2m_objects.c"

void setUp()
{
}

void tearDown()
{
}

void test_LWM2M_INSTANCE_OFFSET_SET_security(void)
{
    uint8_t offsetof_security_operations = offsetof(lwm2m_security_t, operations);
    uint8_t offsetof_security_operations_ids = offsetof(lwm2m_security_t, resource_ids);

    lwm2m_security_t sec;
    lwm2m_security_t * p_instance = &sec;
    LWM2M_INSTANCE_OFFSET_SET(p_instance, lwm2m_security_t);

    TEST_ASSERT_EQUAL_UINT8(offsetof_security_operations, sec.proto.operations_offset);
    TEST_ASSERT_EQUAL_UINT8(offsetof_security_operations_ids, sec.proto.resource_ids_offset);
}


void test_LWM2M_INSTANCE_OFFSET_SET_server(void)
{
    uint8_t offsetof_server_operations = offsetof(lwm2m_server_t, operations);
    uint8_t offsetof_server_operations_ids = offsetof(lwm2m_server_t, resource_ids);

    lwm2m_server_t ser;
    lwm2m_server_t * p_instance = &ser;
    LWM2M_INSTANCE_OFFSET_SET(p_instance, lwm2m_server_t);

    TEST_ASSERT_EQUAL_UINT8(offsetof_server_operations, ser.proto.operations_offset);
    TEST_ASSERT_EQUAL_UINT8(offsetof_server_operations_ids, ser.proto.resource_ids_offset);
}

extern int unity_main(void);

void main(void)
{
	(void)unity_main();
}
```
