## Kconfig
```kconfig
#
# Copyright (c) 2018 Nordic Semiconductor
#
# SPDX-License-Identifier: LicenseRef-BSD-5-Clause-Nordic
#

menu "Nordic LwM2M Library"

rsource "lib/Kconfig"

endmenu
```

## lib/Kconfig
```kconfig
#
# Copyright (c) 2019 Nordic Semiconductor
#
# SPDX-License-Identifier: LicenseRef-BSD-5-Clause-Nordic
#

rsource "coap/Kconfig"
rsource "lwm2m/Kconfig"
rsource "lwm2m_carrier/Kconfig"
```

## lib/lwm2m/Kconfig
```kconfig
#
# Copyright (c) 2018 Nordic Semiconductor ASA
#
# SPDX-License-Identifier: LicenseRef-BSD-5-Clause-Nordic
#

config NRF_LWM2M
	bool "Nordic LwM2M library support"
	select NRF_COAP
	help
	  "Enable LwM2M library"

config NRF_LWM2M_STANDALONE_LIBRARY
	bool "Compile LWM2M as a standalone library"

config NRF_LWM2M_INCLUDE_DEBUG_INFORMATION
	bool "Include debug information in the output library"
	depends on NRF_LWM2M_STANDALONE_LIBRARY

config NRF_LWM2M_ENABLE_LOGS
	bool "Include logs in the LWM2M library."

config NRF_LWM2M_COAP_HANDLER_MAX_INSTANCES
	int "Maximum number of object instance supported by the device."
	depends on NRF_LWM2M
	default 5
	range 1 65535
	help
	  "Maximum number of object instances. Objects are not included as an instance as the handlers are kept in a seperate buffer."

config NRF_LWM2M_COAP_HANDLER_MAX_OBJECTS
	int "Maximum number of objects supported by the device."
	depends on NRF_LWM2M
	default 5
	range 1 65535
	help
	  "As objects are default resource handler for the LWM2M instances when no instanceis registred, this has to be defined to set of memory for the objects that are going to be registered as handlers."

config NRF_LWM2M_MAX_SERVERS
	int "Maximum number of LWM2M servers to connect to."
	depends on NRF_LWM2M
	default 1
	range 1 65535
	help
	  "As bootstrap server is not counted as a server in this sense, the number should reflect how many servers the device is suppose to register to."

config NRF_LWM2M_REGISTER_MAX_LOCATION_LEN
	int "Max number of bytes allocated for location string from remote server."
	depends on NRF_LWM2M
	default 20
	range 1 255
	help
	  "Upon registration the device will get a location string to be used as identifierfor later communication with the server it is registered to. This setting defines the maximum length of the location string a server can return upon registration with a server."

config NRF_LWM2M_CONNECTIVITY_MONITORING_MAX_NETWORK_BEARERS
	int "Max number of network bearers."
	depends on NRF_LWM2M
	default 2
	range 1 255
	help
	  "This setting defines the maximum number of available network bearers which this device can have in the Connectivity Monitoring object."

config NRF_LWM2M_CONNECTIVITY_MONITORING_MAX_IP_ADDRESSES
	int "Max number of IP addresses."
	depends on NRF_LWM2M
	default 2
	range 1 255
	help
	  "This setting defines the maximum number of IP addresses which this device can have in the Connectivity Monitoring object."

config NRF_LWM2M_CONNECTIVITY_MONITORING_MAX_APNS
	int "Max number of APNs."
	depends on NRF_LWM2M
	default 4
	range 1 255
	help
	  "This setting defines the maximum number of APNs which this device can have in the Connectivity Monitoring object."
```

## lib/lwm2m_carrier/Kconfig
```kconfig
#
# Copyright (c) 2018 Nordic Semiconductor ASA
#
# SPDX-License-Identifier: LicenseRef-BSD-5-Clause-Nordic
#

config NRF_LWM2M_CARRIER
	bool "Nordic LwM2M library support"
	select NRF_LWM2M
	help
	  "Enable LwM2M Carrier library"

if NRF_LWM2M_CARRIER

config NRF_LWM2M_CARRIER_STANDALONE_LIBRARY
	bool "Compile CARRIER LWM2M as a standalone library"

config NRF_LWM2M_CARRIER_BOOTSTRAP_URI
	string "Default bootstrap URI"

config NRF_LWM2M_CARRIER_BOOTSTRAP_PSK
	string "Default bootstrap PSK"

config NRF_LWM2M_CARRIER_INCLUDE_DEBUG_INFORMATION
	bool "Include debug information in the output library"
	depends on NRF_LWM2M_CARRIER_STANDALONE_LIBRARY

config NRF_LWM2M_CARRIER_ERASE_TIMEOUT_S
	int "Modem patch erase timeout [s]"
	default 45
	help
	  Based on the level of activity on the network, the modem might be unable
	  to erase the firmware patch in flash. This value is used as a timeout,
	  after which the library will inform the application that
	  the link will be turned off to continue.

config NRF_LWM2M_CARRIER_COAP_CON_INTERVAL
	int "CoAP CON interval"
	default 86400
	help
	  This interval defines how often a CoAP Non-Confirmable notification
	  is sent as Confirmable, according to RFC 7641 section 4.5.

config NRF_LWM2M_CARRIER_SEC_TAG
	int "TLS security tag for Firmware downloads"
	default 11
	help
	  TLS security tag associated with Verizon certificates.
	  Set to -1 to disable TLS.

endif # NRF_LWM2M_CARRIER
```

## lib/lwm2m_vzw/Kconfig
```kconfig
#
# Copyright (c) 2018 Nordic Semiconductor ASA
#
# SPDX-License-Identifier: LicenseRef-BSD-5-Clause-Nordic
#

config NRF_LWM2M_VZW
	bool "Nordic LwM2M library support"
	select NRF_LWM2M
	help
	  "Enable Verizon LwM2M library"

if NRF_LWM2M_VZW

config NRF_LWM2M_VZW_STANDALONE_LIBRARY
	bool "Compile VZW LWM2M as a standalone library"

config NRF_LWM2M_VZW_INCLUDE_DEBUG_INFORMATION
	bool "Include debug information in the output library"
	depends on NRF_LWM2M_VZW_STANDALONE_LIBRARY

config NRF_LWM2M_VZW_SEC_TAG
	int "TLS security tag for Firmware downloads"
	default 11
	help
	  TLS security tag associated with Verizon certificates.
	  Set to -1 to disable TLS.

endif # NRF_LWM2M_VZW
```

## lib/vzw_lwm2m/Kconfig
```kconfig
#
# Copyright (c) 2018 Nordic Semiconductor ASA
#
# SPDX-License-Identifier: LicenseRef-BSD-5-Clause-Nordic
#

config NRF_VZW_LWM2M
	bool "Nordic LwM2M library support"
	select NRF_LWM2M
	help
	  "Enable Verizon LwM2M library"

config NRF_VZW_LWM2M_INCLUDE_DEBUG_INFORMATION
	bool "Include debug information in the output library"
```

## west.yml
```yaml
# The west manifest file (west.yml) for the
# Nordic LwM2M carrier library and the test client application.
#
# The per-workspace west configuration file, lwm2m/.west/config,
# specifies the location of this manifest file like this:
#
#     [manifest]
#     path = lwm2m
#     [zephyr]
#     base = zephyr
#
# See the west documentation for more information:
#
# https://developer.nordicsemi.com/nRF_Connect_SDK/doc/latest/zephyr/guides/west/index.html

manifest:
  # This west.yml requires west 0.7 or later, because the "import"
  # feature used below was introduced then.
  version: 0.7

  # Import projects from the sdk-nrf West manifest.
  # The sdk-nrf West manifest dictates the modules and dependencies
  # versions to import. They can be updated if needed:
  # * Whitelist/blacklist can be used to import modules or not.
  # * Versions/SHA can be overridden here or in separated files.
  projects:

    # Source West manifest. Modules are imported from there.
    - name: nrf
      url: https://github.com/nrfconnect/sdk-nrf
      revision: v1.4.0-rc1
      import:
        name-whitelist:
          - zephyr
          - nrfxlib
          - hal_nordic
          - cmsis
          - mbedtls-nrf

    # Overrides modules/projects versions from nrf import.
    #- name: nrfxlib
    #  url: https://github.com/nrfconnect/sdk-nrfxlib
    #  revision: f1dd2ee510f39e27ea4102bad369c026c0dad147
    #
    #- name: mbedtls-nrf
    #  url: https://github.com/ARMmbed/mbedtls
    #  revision: mbedtls-2.16.6

  # West-related configuration for this repository.
  # This repository should be cloned to lwm2m/lwm2m.
  self:
    path: lwm2m
    import: conf/overrides
```
