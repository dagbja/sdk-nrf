## CMakeLists.txt
```
#
# Copyright (c) 2018 Nordic Semiconductor
#
# SPDX-License-Identifier: LicenseRef-BSD-5-Clause-Nordic
#

cmake_minimum_required(VERSION 3.8.2)

# This sample runs as a non-secure application on nRF91. Therefore, it
# requires the secure_partition_manager that prepares the required
# peripherals to be available for the application.
#
# Configure the SPM image to enable the peripherals that this sample
# needs.
set(spm_CONF_FILE
  prj.conf
  ${CMAKE_CURRENT_LIST_DIR}/child_secure_partition_manager.conf
  )

execute_process(
	COMMAND git describe --always --dirty
	OUTPUT_VARIABLE LWM2M_CLIENT_VERSION
	OUTPUT_STRIP_TRAILING_WHITESPACE
)

execute_process(
	COMMAND hostname
	OUTPUT_VARIABLE LWM2M_CLIENT_BUILD_HOST
	OUTPUT_STRIP_TRAILING_WHITESPACE
)

include($ENV{ZEPHYR_BASE}/cmake/app/boilerplate.cmake NO_POLICY_SCOPE)
project(NONE)

zephyr_cc_option(-Werror)

target_sources(app PRIVATE src/client_leds.c)
target_sources(app PRIVATE src/client_shell.c)
target_sources(app PRIVATE src/modem_logging.c)

add_definitions(-DLWM2M_CLIENT_VERSION=${LWM2M_CLIENT_VERSION})
add_definitions(-DLWM2M_CLIENT_BUILD_HOST=${LWM2M_CLIENT_BUILD_HOST})
target_sources(app PRIVATE src/main.c)

zephyr_include_directories(src)
```

## Kconfig
```
#
# Copyright (c) 2018 Nordic Semiconductor
#
# SPDX-License-Identifier: LicenseRef-BSD-5-Clause-Nordic
#

menu "Zephyr Kernel"

source "Kconfig.zephyr"

endmenu

rsource "../Kconfig"

menu "Nordic LwM2M Client"

config NRF_LWM2M_CLIENT_MODEM_LOGGING
	int "Modem logging"
	default 0
	range 0 2
	help
	  "Enable modem logging. 0 = disabled, 1 = fidoless, 2 = fido"

endmenu
```

## prj.conf
```kconfig
# General config
CONFIG_NEWLIB_LIBC=y
CONFIG_ASSERT=y
CONFIG_BOOT_BANNER=n
CONFIG_NO_OPTIMIZATIONS=y

# Thread analyzer
CONFIG_THREAD_ANALYZER=y
CONFIG_THREAD_NAME=y

# Thread stack guards
CONFIG_MPU_STACK_GUARD=y
CONFIG_BUILTIN_STACK_GUARD=y

# Logging
CONFIG_LOG=y
CONFIG_LOG_BUFFER_SIZE=8192
CONFIG_LOG_STRDUP_MAX_STRING=64
CONFIG_LOG_STRDUP_BUF_COUNT=16

# Network
CONFIG_NETWORKING=y
CONFIG_NET_SOCKETS=y
CONFIG_NET_SOCKETS_OFFLOAD=y
CONFIG_NET_NATIVE=n

# LTE link control
CONFIG_LTE_LINK_CONTROL=y
CONFIG_LTE_AUTO_INIT_AND_CONNECT=n
CONFIG_LTE_NETWORK_MODE_LTE_M=y
CONFIG_LTE_NETWORK_USE_FALLBACK=n

# Shell support
CONFIG_SHELL=y
# Enable support for printing thread usage from shell
CONFIG_KERNEL_SHELL=y
CONFIG_DEVICE_SHELL=n
# Increase the default stack size to have enough
# when running AT commands manually via the shell.
CONFIG_SHELL_STACK_SIZE=4096
CONFIG_SHELL_WILDCARD=n

# BSD library
CONFIG_BSD_LIBRARY=y
CONFIG_BSD_LIBRARY_SYS_INIT=n
CONFIG_BSD_LIBRARY_TRACE_ENABLED=y

# Non-volatile Storage
CONFIG_FLASH=y
CONFIG_NVS=y
CONFIG_MPU_ALLOW_FLASH_WRITE=y

# CoAP
CONFIG_NRF_COAP_RESOURCE_MAX_DEPTH=4
CONFIG_NRF_COAP_PORT_COUNT=0
CONFIG_NRF_COAP_SESSION_COUNT=2
CONFIG_NRF_COAP_MAX_RETRANSMIT_COUNT=2
CONFIG_NRF_COAP_ENABLE_OBSERVE_SERVER=y
CONFIG_NRF_COAP_OBSERVE_MAX_NUM_OBSERVERS=26
CONFIG_NRF_COAP_MESSAGE_QUEUE_SIZE=8
CONFIG_NRF_COAP_MESSAGE_DATA_MAX_SIZE=1024

# LwM2M
CONFIG_NRF_LWM2M=y
CONFIG_NRF_LWM2M_ENABLE_LOGS=y
CONFIG_NRF_LWM2M_MAX_SERVERS=3
CONFIG_NRF_LWM2M_COAP_HANDLER_MAX_OBJECTS=11
CONFIG_NRF_LWM2M_COAP_HANDLER_MAX_INSTANCES=30
CONFIG_NRF_LWM2M_REGISTER_MAX_LOCATION_LEN=50
CONFIG_NRF_LWM2M_CARRIER=y
CONFIG_NRF_LWM2M_CARRIER_BOOTSTRAP_URI="coaps://vmi36865.contabo.host:5784"
# PSK: nordicsecret
CONFIG_NRF_LWM2M_CARRIER_BOOTSTRAP_PSK="6e6f72646963736563726574"

# Library for buttons and LEDs
CONFIG_DK_LIBRARY=y
CONFIG_DK_LIBRARY_INVERT_LEDS=n

# AT Command driver interface with Modem
CONFIG_AT_CMD=y
CONFIG_AT_CMD_RESPONSE_MAX_LEN=2800
CONFIG_AT_CMD_THREAD_STACK_SIZE=2048

# Heap and stacks
CONFIG_HEAP_MEM_POOL_SIZE=4096

CONFIG_DOWNLOAD_CLIENT=y
CONFIG_DOWNLOAD_CLIENT_IPV6=y

# AT command parser
CONFIG_AT_CMD_PARSER=y

# Allow the non-secure application to request reboot
CONFIG_REBOOT=y

# Modem key management
CONFIG_MODEM_KEY_MGMT=y
```

## child_secure_partition_manager.conf
```kconfig
# Add any SPM-related options here.
# Empty at the moment, SECURE_SERVICES are on by default.
CONFIG_BOOT_BANNER=n
CONFIG_SPM_BOOT_SILENTLY=y
```

## src/main.c
```c
/*
 * Copyright (c) 2015 Nordic Semiconductor ASA
 *
 * SPDX-License-Identifier: LicenseRef-BSD-5-Clause-Nordic
 */

#include <zephyr.h>
#include <lwm2m.h>

#if CONFIG_DK_LIBRARY
#include <client_leds.h>
#endif

#include <lwm2m_carrier.h>
#include <modem_logging.h>

int lwm2m_carrier_event_handler(const lwm2m_carrier_event_t * event)
{
    lwm2m_carrier_event_error_t *error_event;
    lwm2m_carrier_event_deferred_t *deferred_event;

    static const char *str[] = {
        [LWM2M_CARRIER_EVENT_BSDLIB_INIT] = "LWM2M_CARRIER_EVENT_BSDLIB_INIT",
        [LWM2M_CARRIER_EVENT_CONNECTING] = "LWM2M_CARRIER_EVENT_CONNECTING",
        [LWM2M_CARRIER_EVENT_CONNECTED] = "LWM2M_CARRIER_EVENT_CONNECTED",
        [LWM2M_CARRIER_EVENT_DISCONNECTING] = "LWM2M_CARRIER_EVENT_DISCONNECTING",
        [LWM2M_CARRIER_EVENT_DISCONNECTED] = "LWM2M_CARRIER_EVENT_DISCONNECTED",
        [LWM2M_CARRIER_EVENT_BOOTSTRAPPED] = "LWM2M_CARRIER_EVENT_BOOTSTRAPPED",
        [LWM2M_CARRIER_EVENT_REGISTERED] = "LWM2M_CARRIER_EVENT_REGISTERED",
        [LWM2M_CARRIER_EVENT_DEFERRED] = "LWM2M_CARRIER_EVENT_DEFERRED",
        [LWM2M_CARRIER_EVENT_FOTA_START] = "LWM2M_CARRIER_EVENT_FOTA_START",
        [LWM2M_CARRIER_EVENT_REBOOT] = "LWM2M_CARRIER_EVENT_REBOOT",
        [LWM2M_CARRIER_EVENT_LTE_READY] = "LWM2M_CARRIER_EVENT_LTE_READY",
        [LWM2M_CARRIER_EVENT_ERROR] = "LWM2M_CARRIER_EVENT_ERROR",
    };

    switch (event->type) {
    case LWM2M_CARRIER_EVENT_BSDLIB_INIT:
    case LWM2M_CARRIER_EVENT_CONNECTING:
    case LWM2M_CARRIER_EVENT_CONNECTED:
    case LWM2M_CARRIER_EVENT_DISCONNECTING:
    case LWM2M_CARRIER_EVENT_DISCONNECTED:
    case LWM2M_CARRIER_EVENT_BOOTSTRAPPED:
    case LWM2M_CARRIER_EVENT_REGISTERED:
    case LWM2M_CARRIER_EVENT_FOTA_START:
    case LWM2M_CARRIER_EVENT_REBOOT:
    case LWM2M_CARRIER_EVENT_LTE_READY:
        LWM2M_INF("Sent event %s", lwm2m_os_log_strdup(str[event->type]));
        break;
    case LWM2M_CARRIER_EVENT_DEFERRED:
        deferred_event = (lwm2m_carrier_event_deferred_t *)(event->data);
        LWM2M_INF("Sent event %s: [%u] %ds", lwm2m_os_log_strdup(str[event->type]),
                  deferred_event->reason, deferred_event->timeout);
        break;
    case LWM2M_CARRIER_EVENT_ERROR:
        error_event = (lwm2m_carrier_event_error_t *)(event->data);
        LWM2M_INF("Sent event %s: [%u] %d", lwm2m_os_log_strdup(str[event->type]),
                  error_event->code, error_event->value);
        break;
    default:
        /* TODO: assert */
        break;
    }

    return 0;
}

/**@brief Recoverable BSD library error. */
void bsd_recoverable_error_handler(uint32_t error)
{
#if CONFIG_DK_LIBRARY
    ARG_UNUSED(error);
    leds_recoverable_error_loop();
#else
    printk("RECOVERABLE ERROR %lu\n", error);
    while (true);
#endif
}

/**@brief Function for application main entry.
 */
int main(void)
{
#if CONFIG_DK_LIBRARY
    // Initialize LEDs and Buttons.
    client_leds_init();
#endif

    printk("\n*** LwM2M client build %s (built on %s) ***",
           STRINGIFY(LWM2M_CLIENT_VERSION), STRINGIFY(LWM2M_CLIENT_BUILD_HOST));

    return 0;
}

#if !defined(CONFIG_LWM2M_CARRIER)
/* LWM2M background thread - should become a separate module. */

/* These should be configurable. */
#define LWM2M_CARRIER_THREAD_STACK_SIZE 4096
#define LWLM2_CARRIER_THREAD_PRIORITY K_LOWEST_APPLICATION_THREAD_PRIO

void lwm2m_carrier_thread_run(void)
{
    // Configure FIDO trace first to ensure we capture lwm2m_carrier_init().
    modem_trace_enable();

    int err = lwm2m_carrier_init(NULL);
    if (err != 0) {
        printk("Failed to initialize the LWM2M carrier library (%d). Exit!\n", err);
        __ASSERT(false, "Failed to initialize the LWM2M carrier library (%d). Exit!\n", err);
        return;
    }

    // Initialize logging.
    modem_logging_init();

    // Non-return function.
    lwm2m_carrier_run();
}

K_THREAD_DEFINE(lwm2m_carrier_thread, LWM2M_CARRIER_THREAD_STACK_SIZE,
                lwm2m_carrier_thread_run, NULL, NULL, NULL,
                LWLM2_CARRIER_THREAD_PRIORITY, 0, NO_WAIT);
#endif
```

## src/app_debug.c
```c
/*
 * Copyright (c) 2019 Nordic Semiconductor ASA
 *
 * SPDX-License-Identifier: LicenseRef-BSD-5-Clause-Nordic
 */

#define LWM2M_LOG_MODULE_NAME lwm2m_debug

#include <zephyr.h>
#include <stdint.h>
#include <string.h>
#include <stdio.h>
#include <lwm2m_instance_storage.h>
#include <app_debug.h>
#include <at_interface.h>


static debug_settings_t m_debug_settings;

void app_debug_init(void)
{
    int ret = lwm2m_debug_settings_load(&m_debug_settings);

    if (ret != sizeof m_debug_settings) {
        app_debug_flag_set(DEBUG_FLAG_DISABLE_PSM);
        app_debug_flag_set(DEBUG_FLAG_SMS_SUPPORT);
    }
}

void app_debug_clear(void)
{
    memset(&m_debug_settings, 0, sizeof(m_debug_settings));
    app_debug_flag_set(DEBUG_FLAG_DISABLE_PSM);

    lwm2m_debug_settings_store(&m_debug_settings);
}

const char * app_debug_imei_get(void)
{
    return m_debug_settings.imei;
}

int32_t app_debug_imei_set(const char * imei)
{
    memset(m_debug_settings.imei, 0, sizeof(m_debug_settings.imei));
    strncpy(m_debug_settings.imei, imei, sizeof(m_debug_settings.imei) - 1);

    return lwm2m_debug_settings_store(&m_debug_settings);
}

const char * app_debug_msisdn_get(void)
{
    return m_debug_settings.msisdn;
}

int32_t app_debug_msisdn_set(const char * msisdn)
{
    memset(m_debug_settings.msisdn, 0, sizeof(m_debug_settings.msisdn));
    strncpy(m_debug_settings.msisdn, msisdn, sizeof(m_debug_settings.msisdn) - 1);

    return lwm2m_debug_settings_store(&m_debug_settings);
}

bool app_debug_flag_is_set(uint32_t flag)
{
    return ((m_debug_settings.flags & flag) == flag);
}

int32_t app_debug_flag_set(uint32_t flag)
{
    m_debug_settings.flags |= flag;

    return lwm2m_debug_settings_store(&m_debug_settings);
}

int32_t app_debug_flag_clear(uint32_t flag)
{
    m_debug_settings.flags &= ~flag;

    return lwm2m_debug_settings_store(&m_debug_settings);
}

const char * app_debug_modem_logging_get(void)
{
    return m_debug_settings.modem_logging;
}

int32_t app_debug_modem_logging_set(const char * modem_logging)
{
    memset(m_debug_settings.modem_logging, 0, sizeof(m_debug_settings.modem_logging));
    strncpy(m_debug_settings.modem_logging, modem_logging, sizeof(m_debug_settings.modem_logging) - 1);

    return lwm2m_debug_settings_store(&m_debug_settings);
}

static void modem_trace_enable(void)
{
    /* GPIO configurations for trace and debug */
    #define CS_PIN_CFG_TRACE_CLK    21 //GPIO_OUT_PIN21_Pos
    #define CS_PIN_CFG_TRACE_DATA0  22 //GPIO_OUT_PIN22_Pos
    #define CS_PIN_CFG_TRACE_DATA1  23 //GPIO_OUT_PIN23_Pos
    #define CS_PIN_CFG_TRACE_DATA2  24 //GPIO_OUT_PIN24_Pos
    #define CS_PIN_CFG_TRACE_DATA3  25 //GPIO_OUT_PIN25_Pos

    // Configure outputs.
    // CS_PIN_CFG_TRACE_CLK
    NRF_P0_NS->PIN_CNF[CS_PIN_CFG_TRACE_CLK] = (GPIO_PIN_CNF_DRIVE_H0H1 << GPIO_PIN_CNF_DRIVE_Pos) |
                                               (GPIO_PIN_CNF_INPUT_Disconnect << GPIO_PIN_CNF_INPUT_Pos);

    // CS_PIN_CFG_TRACE_DATA0
    NRF_P0_NS->PIN_CNF[CS_PIN_CFG_TRACE_DATA0] = (GPIO_PIN_CNF_DRIVE_H0H1 << GPIO_PIN_CNF_DRIVE_Pos) |
                                                 (GPIO_PIN_CNF_INPUT_Disconnect << GPIO_PIN_CNF_INPUT_Pos);

    // CS_PIN_CFG_TRACE_DATA1
    NRF_P0_NS->PIN_CNF[CS_PIN_CFG_TRACE_DATA1] = (GPIO_PIN_CNF_DRIVE_H0H1 << GPIO_PIN_CNF_DRIVE_Pos) |
                                                 (GPIO_PIN_CNF_INPUT_Disconnect << GPIO_PIN_CNF_INPUT_Pos);

    // CS_PIN_CFG_TRACE_DATA2
    NRF_P0_NS->PIN_CNF[CS_PIN_CFG_TRACE_DATA2] = (GPIO_PIN_CNF_DRIVE_H0H1 << GPIO_PIN_CNF_DRIVE_Pos) |
                                                 (GPIO_PIN_CNF_INPUT_Disconnect << GPIO_PIN_CNF_INPUT_Pos);

    // CS_PIN_CFG_TRACE_DATA3
    NRF_P0_NS->PIN_CNF[CS_PIN_CFG_TRACE_DATA3] = (GPIO_PIN_CNF_DRIVE_H0H1 << GPIO_PIN_CNF_DRIVE_Pos) |
                                                 (GPIO_PIN_CNF_INPUT_Disconnect << GPIO_PIN_CNF_INPUT_Pos);

    NRF_P0_NS->DIR = 0xFFFFFFFF;
}


// fidoless modem trace options:
//   1,0 = disable
//   1,1 = coredump only
//   1,2 = generic (and coredump)
//   1,3 = lwm2m   (and coredump)
//   1,4 = ip only (and coredump)
void app_debug_modem_logging_enable(void)
{
    if ((m_debug_settings.modem_logging[0] == 0) ||
        (strcmp(m_debug_settings.modem_logging, "0") == 0)) {
        at_send_command("AT%XMODEMTRACE=1,0", false);
    } else if (strcmp(m_debug_settings.modem_logging, "1") == 0) {
        at_send_command("AT%XMODEMTRACE=1,2", false);
    } else if (strcmp(m_debug_settings.modem_logging, "2") == 0) {
        at_send_command("AT%XMODEMTRACE=1,1", false);
        modem_trace_enable();
    } else if (strcmp(m_debug_settings.modem_logging, "3") == 0) {
        at_send_command("AT%XMODEMTRACE=1,3", false);
    } else if (strcmp(m_debug_settings.modem_logging, "4") == 0) {
        at_send_command("AT%XMODEMTRACE=1,4", false);
    } else if (strlen(m_debug_settings.modem_logging) == 64) {
        char at_command[128];
        sprintf(at_command, "AT%%XMODEMTRACE=2,,3,%s", m_debug_settings.modem_logging);
        at_send_command(at_command, false);
    }
}
```

## src/app_debug.h
```c
/*
 * Copyright (c) 2019 Nordic Semiconductor ASA
 *
 * SPDX-License-Identifier: LicenseRef-BSD-5-Clause-Nordic
 */

#ifndef APP_DEBUG_H__
#define APP_DEBUG_H__

#include <stdint.h>

#define DEBUG_FLAG_DISABLE_PSM  0x01       /**< Set if disable PSM. */
#define DEBUG_FLAG_SMS_SUPPORT  0x02       /**< Set if enable SMS support. */
#define DEBUG_FLAG_PDN_SUPPORT  0x04       /**< Set if using PDN settings. */

/**@brief Configurable device values. */
typedef struct {
    char imei[16];                /**< Static configured IMEI to overwrite value from SIP, used for debugging. */
    char msisdn[16];              /**< Static configured MSISDN to overwrite value from SIM, used for debugging. */
    char modem_logging[65];       /**< Modem logging: 0=off, 1=fidoless, 2=fido, other=XMODEMTRACE bitmap */
    uint32_t flags;               /**< Flags to control application behaviour. */
} debug_settings_t;

void app_debug_init(void);
void app_debug_clear(void);

const char * app_debug_imei_get(void);
int32_t app_debug_imei_set(const char * imei);

const char * app_debug_msisdn_get(void);
int32_t app_debug_msisdn_set(const char * msisdn);

bool app_debug_flag_is_set(uint32_t flag);
int32_t app_debug_flag_set(uint32_t flag);
int32_t app_debug_flag_clear(uint32_t flag);

const char * app_debug_modem_logging_get(void);
int32_t app_debug_modem_logging_set(const char * modem_logging);
void app_debug_modem_logging_enable(void);

#endif // APP_DEBUG_H__
```

## src/at_interface.c
```c
/*
 * Copyright (c) 2019 Nordic Semiconductor ASA
 *
 * SPDX-License-Identifier: LicenseRef-BSD-5-Clause-Nordic
 */

#include <zephyr.h>
#include <stdio.h>
#include <net/socket.h>
#include <pdn_management.h>

#define APP_MAX_AT_READ_LENGTH          256
#define APP_MAX_AT_WRITE_LENGTH         256


int at_apn_setup_wait_for_ipv6(char * apn)
{
    char write_buffer[APP_MAX_AT_WRITE_LENGTH];
    char read_buffer[APP_MAX_AT_READ_LENGTH];

    int apn_handle = -1;

    int at_socket_fd;
    int at_socket_cgev_fd;

    if (apn == NULL) {
        return -1;
    }

    at_socket_cgev_fd = socket(AF_LTE, 0, NPROTO_AT);
    if (at_socket_cgev_fd < 0) {
        printk("socket() failed\n");
    }

    // Subscribe to CGEV
    const char at_cgerep[] = "AT+CGEREP=1\r\n";
    int sent_cgev_length = send(at_socket_cgev_fd, at_cgerep, sizeof(at_cgerep), 0);
    if (sent_cgev_length == -1)
    {
        // Should still be -1.
        printk("IPv6 APN failed sending CGEREP=1\n");
        return -1;
    }

    int received_cgev_length = 0;
    do {
        memset(read_buffer, 0, sizeof(read_buffer));
        received_cgev_length = recv(at_socket_cgev_fd, read_buffer, sizeof(read_buffer), 0);
    } while (received_cgev_length <= 0);

    // Check if subscription went OK.
    if ((received_cgev_length <= 0) || strstr(read_buffer, "OK\r\n") == NULL)
    {
        printk("IPv6 APN CGERRP response not ok: %s\n", read_buffer);
        return -1;
    }

    // Set up APN which implicitly creates a CID.
    apn_handle = pdn_init_and_connect(apn);

    bool cid_found = false;
    int  cid_number = 0;
    if (apn_handle > -1)
    {
        at_socket_fd = socket(AF_LTE, 0, NPROTO_AT);
        if (at_socket_fd < 0) {
            printk("socket() failed\n");
        }

        // Loop through possible CID to and lookup the APN.
        for (; cid_number < 12; cid_number++) {
            snprintf(write_buffer, sizeof(write_buffer), "AT+CGCONTRDP=%u\r\n", cid_number);
            int sent_length = send(at_socket_fd, write_buffer, strlen(write_buffer), 0);
            if (sent_length == -1)
            {
                break;
            }
            memset(read_buffer, 0, sizeof(read_buffer));
            int revieved_length = recv(at_socket_fd, read_buffer, sizeof(read_buffer), 0);

            if ((revieved_length > 0) && (strstr(read_buffer, apn) != NULL))
            {
                cid_found = true;
                break;
            }

            if (revieved_length > 0 && (!cid_found))
            {
                // Test oposite casing variant of the APN name.
                char oposite_case[64];
                memcpy(oposite_case, apn, strlen(apn));

                if (apn[0] >= 'a')
                {
                    for (uint8_t i = 0; i < strlen(apn); i++)
                    {
                        oposite_case[i] = apn[i] - 32;
                    }
                } else {
                    for (uint8_t i = 0; i < strlen(apn); i++)
                    {
                        oposite_case[i] = apn[i] + 32;
                    }
                }
                oposite_case[strlen(apn)] = '\0';

                if ((revieved_length > 0) && (strstr(read_buffer, oposite_case) != NULL))
                {
                    cid_found = true;
                    break;
                }
            }
        }

        // Clean up CID lookup socket.
        close(at_socket_fd);
    }

    // Now block until IPv6 is ready to be used.
    if (cid_found)
    {
        bool ipv6_active = false;
        do
        {
            memset(read_buffer, 0, sizeof(read_buffer));
            received_cgev_length = recv(at_socket_cgev_fd, read_buffer, sizeof(read_buffer), 0);
            if ((received_cgev_length > 0) && (strstr(read_buffer, "CGEV: IPV6") != NULL))
            {
                // We have a hit on IPV6 link up notification, lets verify the CID.
                char * p_start = strstr(read_buffer, "IPV6");
                int cid_candidate = atoi(&p_start[strlen("IPV6") + 1]);
                if (cid_candidate == cid_number)
                {
                    ipv6_active = true;
                }
            }
        } while (!ipv6_active);
    }

    close(at_socket_cgev_fd);

    return apn_handle;
}


int at_read_imei_and_msisdn(char *p_imei, int imei_len, char *p_msisdn, int msisdn_len)
{
    char write_buffer[APP_MAX_AT_WRITE_LENGTH];
    char read_buffer[APP_MAX_AT_READ_LENGTH];

    int at_socket_fd;
    int length;
    int retval = 0;

    if (imei_len < 15 || msisdn_len < 10) {
        return EINVAL;
    }

    at_socket_fd = socket(AF_LTE, 0, NPROTO_AT);
    if (at_socket_fd < 0) {
        printk("socket() failed\n");
        return EIO;
    }

    // Read IMEI
    const char *at_cgsn = "AT+CGSN";
    snprintf(write_buffer, APP_MAX_AT_WRITE_LENGTH, "%s", at_cgsn);
    length = send(at_socket_fd, write_buffer, strlen(write_buffer), 0);

    if (length == strlen(write_buffer)) {
        memset(p_imei, 0, imei_len);
        length = recv(at_socket_fd, read_buffer, APP_MAX_AT_READ_LENGTH, 0);
        if (length > 0) {
            memcpy(p_imei, read_buffer, 15);
        } else {
            printk("recv(%s) failed\n", at_cgsn);
            retval = EIO;
        }
    } else {
        printk("send(%s) failed\n", at_cgsn);
        retval = EIO;
    }

    // Read MSISDN
    const char *at_cnum = "AT+CNUM";
    snprintf(write_buffer, APP_MAX_AT_WRITE_LENGTH, "%s", at_cnum);
    length = send(at_socket_fd, write_buffer, strlen(write_buffer), 0);

    if (length == strlen(write_buffer)) {
        memset(p_msisdn, 0, msisdn_len);
        length = recv(at_socket_fd, read_buffer, APP_MAX_AT_READ_LENGTH, 0);
        if (length > 0) {
            char * p_start = strstr(read_buffer, "\"");
            if (p_start) {
                char * p_end = strstr(p_start + 1, "\"");
                if (p_end && (p_end - p_start - 1 >= 10)) {
                    // FIXME: This only uses the last 10 digits
                    memcpy(p_msisdn, p_end - 10, 10);
                }
            }
            if (!p_msisdn[0]) {
                // SIM has no number
                // FIXME: For debug purpose use the last 10 digits of IMEI
                memcpy(p_msisdn, &p_imei[5], 10);
            }
        } else {
            printk("recv(%s) failed\n", at_cnum);
            retval = EIO;
        }
    } else {
        printk("send(%s) failed\n", at_cnum);
        retval = EIO;
    }

    close(at_socket_fd);

    return retval;
}

static int copy_and_convert_iccid(const char *src, uint32_t src_len, char *dst, uint32_t *p_dst_len)
{
    if (*p_dst_len < src_len) {
        return EINVAL;
    }

    int len = 0;

    // https://www.etsi.org/deliver/etsi_ts/102200_102299/102221/13.02.00_60/ts_102221v130200p.pdf chapter 13.2
    for (int i = 0; i < src_len; i += 2) {
        dst[len++] = src[i + 1];
        if (src[i] != 'F') {
            dst[len++] = src[i];
        }
    }

    *p_dst_len = len;

    return 0;
}

int at_read_sim_iccid(char *p_iccid, uint32_t * p_iccid_len)
{
    char write_buffer[APP_MAX_AT_WRITE_LENGTH];
    char read_buffer[APP_MAX_AT_READ_LENGTH];

    int at_socket_fd;
    int length;
    int retval = 0;

    at_socket_fd = socket(AF_LTE, 0, NPROTO_AT);
    if (at_socket_fd < 0) {
        printk("socket() failed\n");
        return EIO;
    }

    // Read SIM ICCID
    const char *at_crsm = "AT+CRSM=176,12258,0,0,10";
    snprintf(write_buffer, APP_MAX_AT_WRITE_LENGTH, "%s", at_crsm);
    length = send(at_socket_fd, write_buffer, strlen(write_buffer), 0);

    if (length == strlen(write_buffer)) {
        length = recv(at_socket_fd, read_buffer, APP_MAX_AT_READ_LENGTH, 0);
        if (length > 0) {
            char * p_start = strstr(read_buffer, "\"");
            if (p_start) {
                char * p_end = strstr(p_start + 1, "\"");
                if (p_end) {
                    retval = copy_and_convert_iccid(p_start + 1, p_end - p_start - 1, p_iccid, p_iccid_len);
                }
            }
        } else {
            printk("recv(%s) failed\n", at_crsm);
            retval = EIO;
        }
    } else {
        printk("send(%s) failed\n", at_crsm);
        retval = EIO;
    }

    close(at_socket_fd);

    return retval;
}

int at_read_firmware_version(char *p_fw_version, uint32_t *p_fw_version_len)
{
    char read_buffer[APP_MAX_AT_READ_LENGTH];

    int at_socket_fd;
    int length;
    int retval = 0;

    at_socket_fd = socket(AF_LTE, 0, NPROTO_AT);
    if (at_socket_fd < 0) {
        printk("socket() failed\n");
        return EIO;
    }

    // Read Modem version
    const char at_cgmr[] = "AT+CGMR";
    length = send(at_socket_fd, at_cgmr, sizeof(at_cgmr) - 1, 0);

    if (length == sizeof(at_cgmr) - 1) {
        length = recv(at_socket_fd, read_buffer, APP_MAX_AT_READ_LENGTH, 0);
        if (length > 0) {
            char * p_end = strstr(read_buffer, "\r");
            if (p_end) {
                uint32_t len = (uint32_t)(p_end - read_buffer);
                memcpy(p_fw_version, read_buffer, len);
                p_fw_version[len] = '\0';
                *p_fw_version_len = len;
            } else {
                retval = EINVAL;
            }
        } else {
            printk("recv(%s) failed\n", at_cgmr);
            retval = EIO;
        }
    } else {
        printk("send(%s) failed\n", at_cgmr);
        retval = EIO;
    }

    close(at_socket_fd);

    return retval;
}

int at_send_command(const char *at_command, bool do_logging)
{
    char write_buffer[APP_MAX_AT_WRITE_LENGTH];
    char read_buffer[APP_MAX_AT_READ_LENGTH];

    int at_socket_fd;
    int length;
    int retval = 0;

    at_socket_fd = socket(AF_LTE, 0, NPROTO_AT);
    if (at_socket_fd < 0) {
        printk("socket() failed\n");
        return EIO;
    }

    snprintf(write_buffer, APP_MAX_AT_WRITE_LENGTH, "%s", at_command);
    length = send(at_socket_fd, write_buffer, strlen(write_buffer), 0);

    if (length == strlen(write_buffer)) {
        length = recv(at_socket_fd, read_buffer, APP_MAX_AT_READ_LENGTH, 0);
        if (length > 0) {
            if (do_logging) {
                printk("%s", read_buffer);
            }
        } else {
            printk("recv() failed\n");
            retval = EIO;
        }
    } else {
        printk("send() failed\n");
        retval = EIO;
    }

    close(at_socket_fd);

    return retval;
}
```

## src/at_interface.h
```c
/*
 * Copyright (c) 2019 Nordic Semiconductor ASA
 *
 * SPDX-License-Identifier: LicenseRef-BSD-5-Clause-Nordic
 */

#ifndef AT_INTERFACE_H__
#define AT_INTERFACE_H__

int at_read_imei_and_msisdn(char *p_imei, int imei_len, char *p_msisdn, int msisdn_len);
int at_read_sim_iccid(char *p_iccid, uint32_t * p_iccid_len);
int at_read_firmware_version(char *p_fw_version, uint32_t * p_fw_version_len);
int at_send_command(const char *at_command, bool do_logging);

#endif // AT_INTERFACE_H__
```

## src/buttons_and_leds.c
```c
/*
 * Copyright (c) 2019 Nordic Semiconductor ASA
 *
 * SPDX-License-Identifier: LicenseRef-BSD-5-Clause-Nordic
 */

#if CONFIG_DK_LIBRARY

#include <zephyr.h>
#include <dk_buttons_and_leds.h>
#include <lwm2m_security.h>
#include <lwm2m_carrier_main.h>

/**< Interval in milliseconds between each time status LEDs are updated. */
#define APP_LEDS_UPDATE_INTERVAL 500

/* Structures for delayed work */
static struct k_delayed_work leds_update_work;


/**@brief Callback for button events from the DK buttons and LEDs library. */
static void app_button_handler(u32_t buttons, u32_t has_changed)
{
    lwm2m_state_t app_state = lwm2m_state_get();

    if (buttons & 0x01) // Button 1 has changed
    {
        if (!(buttons & 0x08)) // Switch 2 in right position
        {
            printk("Reset bootstrap!\n");
            lwm2m_bootstrap_clear();
            lwm2m_request_reset();
        }
        else if (app_state == LWM2M_STATE_DISCONNECTED)
        {
            lwm2m_request_connect();
        }
        else if (app_state == LWM2M_STATE_IDLE)
        {
            lwm2m_request_server_update(1, true);
        }
    }
    else if (buttons & 0x02) // Button 2 has changed
    {
        if (!(buttons & 0x08)) // Switch 2 in right position
        {
            printk("System shutdown!\n");
            lwm2m_system_shutdown();
        }
        else if (app_state == LWM2M_STATE_IDLE)
        {
            app_state = LWM2M_STATE_SERVER_DEREGISTER;
        }
        else if (app_state == LWM2M_STATE_DISCONNECTED)
        {
            lwm2m_request_reset();
        }
    }
}

static void app_leds_get_state(u8_t *on, u8_t *blink)
{
    *on = 0;
    *blink = 0;

    switch (lwm2m_state_get())
    {
        case LWM2M_STATE_BOOTING:
            *blink = DK_LED1_MSK;
            break;

        case LWM2M_STATE_DISCONNECTED:
            *on = DK_LED1_MSK;
            break;

        case LWM2M_STATE_BS_CONNECT:
        case LWM2M_STATE_BS_CONNECT_WAIT:
            *blink = (DK_LED1_MSK | DK_LED2_MSK);
            break;

        case LWM2M_STATE_BS_CONNECT_RETRY_WAIT:
            *blink = (DK_LED2_MSK | DK_LED4_MSK);
            break;

        case LWM2M_STATE_BS_CONNECTED:
        case LWM2M_STATE_BOOTSTRAP_REQUESTED:
            *on = DK_LED1_MSK;
            *blink = DK_LED2_MSK;
            break;

        case LWM2M_STATE_BOOTSTRAP_WAIT:
            *on = DK_LED1_MSK;
            *blink = (DK_LED2_MSK | DK_LED4_MSK);
            break;

        case LWM2M_STATE_BOOTSTRAPPING:
        case LWM2M_STATE_BOOTSTRAP_TIMEDOUT:
            *on = (DK_LED1_MSK | DK_LED2_MSK);
            *blink = DK_LED4_MSK;
            break;

        case LWM2M_STATE_BS_HOLD_OFF:
        case LWM2M_STATE_CLIENT_HOLD_OFF:
            *on = (DK_LED1_MSK | DK_LED2_MSK);
            break;

        case LWM2M_STATE_SERVER_CONNECT:
        case LWM2M_STATE_SERVER_CONNECT_WAIT:
            *blink = (DK_LED1_MSK | DK_LED3_MSK);
            break;

        case LWM2M_STATE_SERVER_CONNECT_RETRY_WAIT:
            *blink = (DK_LED3_MSK | DK_LED4_MSK);
            break;

        case LWM2M_STATE_SERVER_CONNECTED:
            *on = DK_LED1_MSK;
            *blink = DK_LED3_MSK;
            break;

        case LWM2M_STATE_SERVER_REGISTER_WAIT:
            *on = DK_LED1_MSK;
            *blink = (DK_LED3_MSK | DK_LED4_MSK);
            break;

        case LWM2M_STATE_IDLE:
            *on = (DK_LED1_MSK | DK_LED3_MSK);
            break;

        case LWM2M_STATE_REQUEST_LINK_UP:
        case LWM2M_STATE_REQUEST_LINK_DOWN:
        case LWM2M_STATE_REQUEST_CONNECT:
        case LWM2M_STATE_SERVER_DEREGISTER:
        case LWM2M_STATE_SERVER_DEREGISTERING:
        case LWM2M_STATE_REQUEST_DISCONNECT:
            *on = DK_LED3_MSK;
            *blink = DK_LED1_MSK;
            break;

        case LWM2M_STATE_MODEM_FIRMWARE_UPDATE:
            *blink = DK_LED1_MSK | DK_LED2_MSK | DK_LED3_MSK | DK_LED4_MSK;
            break;

        case LWM2M_STATE_SHUTDOWN:
        case LWM2M_STATE_RESET:
            *blink = DK_LED4_MSK;
            break;
    }
}

/**@brief Update LEDs state. */
static void app_leds_update(struct k_work *work)
{
        static bool led_on;
        static u8_t current_led_on_mask;
        u8_t led_on_mask, led_blink_mask;

        ARG_UNUSED(work);

        /* Set led_on_mask to match current state. */
        app_leds_get_state(&led_on_mask, &led_blink_mask);

        if (lwm2m_did_bootstrap())
        {
            /* Only turn on LED2 if bootstrap was done. */
            led_on_mask |= DK_LED2_MSK;
        }

        led_on = !led_on;
        if (led_on) {
                led_on_mask |= led_blink_mask;
                if (led_blink_mask == 0) {
                    // Only blink LED4 if no other led is blinking
                    led_on_mask |= DK_LED4_MSK;
                }
        } else {
                led_on_mask &= ~led_blink_mask;
                led_on_mask &= ~DK_LED4_MSK;
        }

        if (led_on_mask != current_led_on_mask) {
                dk_set_leds(led_on_mask);
                current_led_on_mask = led_on_mask;
        }

        k_delayed_work_submit(&leds_update_work, APP_LEDS_UPDATE_INTERVAL);
}

/**@brief Check buttons pressed at startup. */
static void check_buttons_pressed(void)
{
    u32_t button_state = 0;
    dk_read_buttons(&button_state, NULL);

    // Check if button 1 pressed during startup
    if (button_state & 0x01) {
        lwm2m_factory_reset();

        printk("Factory reset!\n");
        k_delayed_work_cancel(&leds_update_work);
        while (true) { // Blink all LEDs
            dk_set_leds_state(DK_LED1_MSK | DK_LED2_MSK | DK_LED3_MSK | DK_LED4_MSK, 0);
            k_sleep(250);
            dk_set_leds_state(0, DK_LED1_MSK | DK_LED2_MSK | DK_LED3_MSK | DK_LED4_MSK);
            k_sleep(250);
        }
    }
}

void leds_error_loop(void)
{
    k_delayed_work_cancel(&leds_update_work);

    /* Blinking all LEDs ON/OFF in pairs (1 and 2, 3 and 4) if there is an error. */
    while (true) {
        dk_set_leds_state(DK_LED1_MSK | DK_LED2_MSK, DK_LED3_MSK | DK_LED4_MSK);
        k_sleep(250);
        dk_set_leds_state(DK_LED3_MSK | DK_LED4_MSK, DK_LED1_MSK | DK_LED2_MSK);
        k_sleep(250);
    }
}

void leds_recoverable_error_loop(void)
{
    k_delayed_work_cancel(&leds_update_work);

    /* Blinking all LEDs ON/OFF in pairs (1 and 3, 2 and 4) if there is an recoverable error. */
    while (true) {
        dk_set_leds_state(DK_LED1_MSK | DK_LED3_MSK, DK_LED2_MSK | DK_LED4_MSK);
        k_sleep(250);
        dk_set_leds_state(DK_LED2_MSK | DK_LED4_MSK, DK_LED1_MSK | DK_LED3_MSK);
        k_sleep(250);
    }
}

/**@brief Initializes buttons and LEDs, using the DK buttons and LEDs library. */
void buttons_and_leds_init(void)
{
    dk_buttons_init(app_button_handler);
    dk_leds_init();
    dk_set_leds_state(0x00, DK_ALL_LEDS_MSK);

    k_delayed_work_init(&leds_update_work, app_leds_update);
    k_delayed_work_submit(&leds_update_work, APP_LEDS_UPDATE_INTERVAL);

    check_buttons_pressed();
}

void buttons_and_leds_uninit(void)
{
     k_delayed_work_cancel(&leds_update_work);
}

#endif // CONFIG_DK_LIBRARY
```

## src/buttons_and_leds.h
```c
/*
 * Copyright (c) 2019 Nordic Semiconductor ASA
 *
 * SPDX-License-Identifier: LicenseRef-BSD-5-Clause-Nordic
 */

#ifndef BUTTONS_AND_LEDS_H__
#define BUTTONS_AND_LEDS_H__

void buttons_and_leds_init(void);
void buttons_and_leds_uninit(void);

void leds_recoverable_error_loop(void);
void leds_error_loop(void);

#endif // BUTTONS_AND_LEDS_H__
```

## src/client_leds.c
```c
/*
 * Copyright (c) 2019 Nordic Semiconductor ASA
 *
 * SPDX-License-Identifier: LicenseRef-BSD-5-Clause-Nordic
 */

#if CONFIG_DK_LIBRARY

#include <zephyr.h>
#include <dk_buttons_and_leds.h>
#include <lwm2m_security.h>
#include <lwm2m_carrier_main.h>

/**< Interval in milliseconds between each time status LEDs are updated. */
#define APP_LEDS_UPDATE_INTERVAL K_MSEC(500)

/* Structures for delayed work */
static struct k_delayed_work leds_update_work;

static void app_leds_get_state(uint8_t *on, uint8_t *blink)
{
    *on = 0;
    *blink = 0;

    switch (lwm2m_state_get())
    {
        case LWM2M_STATE_BOOTING:
            *blink = DK_LED1_MSK;
            break;

        case LWM2M_STATE_DISCONNECTED:
            *on = DK_LED1_MSK;
            break;

        case LWM2M_STATE_IDLE:
            *on = (DK_LED1_MSK | DK_LED3_MSK);
            break;

        case LWM2M_STATE_REQUEST_LINK_UP:
        case LWM2M_STATE_REQUEST_LINK_DOWN:
        case LWM2M_STATE_REQUEST_CONNECT:
        case LWM2M_STATE_REQUEST_DISCONNECT:
            *on = DK_LED3_MSK;
            *blink = DK_LED1_MSK;
            break;

        case LWM2M_STATE_MODEM_FIRMWARE_UPDATE:
            *blink = DK_LED1_MSK | DK_LED2_MSK | DK_LED3_MSK | DK_LED4_MSK;
            break;

        case LWM2M_STATE_SHUTDOWN:
        case LWM2M_STATE_RESET:
            *blink = DK_LED4_MSK;
            break;

        case LWM2M_STATE_ERROR:
            *blink = DK_LED1_MSK | DK_LED2_MSK | DK_LED3_MSK | DK_LED4_MSK;
            break;
    }
}

/**@brief Update LEDs state. */
static void app_leds_update(struct k_work *work)
{
        static bool led_on;
        static uint8_t current_led_on_mask;
        uint8_t led_on_mask, led_blink_mask;

        ARG_UNUSED(work);

        /* Set led_on_mask to match current state. */
        app_leds_get_state(&led_on_mask, &led_blink_mask);

        if (lwm2m_did_bootstrap())
        {
            /* Only turn on LED2 if bootstrap was done. */
            led_on_mask |= DK_LED2_MSK;
        }

        led_on = !led_on;
        if (led_on) {
                led_on_mask |= led_blink_mask;
                if (led_blink_mask == 0) {
                    // Only blink LED4 if no other led is blinking
                    led_on_mask |= DK_LED4_MSK;
                }
        } else {
                led_on_mask &= ~led_blink_mask;
                led_on_mask &= ~DK_LED4_MSK;
        }

        if (led_on_mask != current_led_on_mask) {
                dk_set_leds(led_on_mask);
                current_led_on_mask = led_on_mask;
        }

        k_delayed_work_submit(&leds_update_work, APP_LEDS_UPDATE_INTERVAL);
}

void leds_recoverable_error_loop(void)
{
    k_delayed_work_cancel(&leds_update_work);

    /* Blinking all LEDs ON/OFF in pairs (1 and 3, 2 and 4) if there is an recoverable error. */
    while (true) {
        dk_set_leds_state(DK_LED1_MSK | DK_LED3_MSK, DK_LED2_MSK | DK_LED4_MSK);
        k_sleep(K_MSEC(250));
        dk_set_leds_state(DK_LED2_MSK | DK_LED4_MSK, DK_LED1_MSK | DK_LED3_MSK);
        k_sleep(K_MSEC(250));
    }
}

/**@brief Initializes LEDs, using the DK LEDs library. */
void client_leds_init(void)
{
    dk_leds_init();
    dk_set_leds_state(0x00, DK_ALL_LEDS_MSK);

    k_delayed_work_init(&leds_update_work, app_leds_update);
    k_delayed_work_submit(&leds_update_work, APP_LEDS_UPDATE_INTERVAL);
}

#endif // CONFIG_DK_LIBRARY
```

## src/client_leds.h
```c
/*
 * Copyright (c) 2019 Nordic Semiconductor ASA
 *
 * SPDX-License-Identifier: LicenseRef-BSD-5-Clause-Nordic
 */

#ifndef CLIENT_LEDS_H__
#define CLIENT_LEDS_H__

void client_leds_init(void);
void leds_recoverable_error_loop(void);

#endif // CLIENT_LEDS_H__
```

## src/common.h
```c
/*
 * Copyright (c) 2019 Nordic Semiconductor ASA
 *
 * SPDX-License-Identifier: LicenseRef-BSD-5-Clause-Nordic
 */

#include <stdint.h>
#include <lwm2m_api.h>

/**@brief Helper function to get the access from an instance and a remote. */
uint32_t common_lwm2m_access_remote_get(uint16_t         * p_access,
                                     lwm2m_instance_t * p_instance,
                                     struct sockaddr  * p_remote);
```

## src/dfusock.c
```c
/*
 * Copyright (c) 2019 Nordic Semiconductor ASA
 *
 * SPDX-License-Identifier: LicenseRef-BSD-5-Clause-Nordic
 */

#include <stdint.h>
#include <stddef.h>
#include <lwm2m.h>
#include <net/socket.h>
#include <nrf_socket.h>

static int dfusock = -1;

int dfusock_fragment_send(const void *buf, size_t len)
{
	int sent;

	__ASSERT_NO_MSG(buf);

	LWM2M_INF("Sending fragment (%u) to modem..", len);

	sent = send(dfusock, buf, len, 0);
	if (sent < 0) {
		LWM2M_ERR("Failed to send(), errno %d", errno);
		return -errno;
	}

	return 0;
}

int dfusock_offset_get(uint32_t *off)
{
	int err;
	nrf_socklen_t len;

	__ASSERT_NO_MSG(off);

	len = sizeof(*off);
	err = nrf_getsockopt(dfusock, NRF_SOL_DFU, NRF_SO_DFU_OFFSET, off,
			     &len);
	if (err) {
		/* LWM2M_ERR("Failed to retrieve offset, errno %d", errno); */
		return -errno;
	}

	return 0;
}

int dfusock_offset_set(uint32_t off)
{
	int err;
	nrf_socklen_t len;

	len = sizeof(off);
	err = nrf_setsockopt(dfusock, NRF_SOL_DFU, NRF_SO_DFU_OFFSET, &off,
			     len);
	if (err) {
		/* Fatal */
		LWM2M_ERR("Failed to set offset, errno %d", errno);
		return -errno;
	}

	return 0;
}

int dfusock_version_get(uint8_t *buf, size_t len)
{
	int err;
	nrf_socklen_t ver_len;

	__ASSERT_NO_MSG(len >= sizeof(nrf_dfu_fw_version_t));

	ver_len = sizeof(nrf_dfu_fw_version_t);
	err = nrf_getsockopt(dfusock, NRF_SOL_DFU, NRF_SO_DFU_FW_VERSION, buf,
			     &ver_len);
	if (err) {
		/* Fatal */
		LWM2M_ERR("Failed to read firmware version, errno %d", errno);
		return -errno;
	}

	/* NULL terminate, if buffer is large enough */
	if (len > sizeof(nrf_dfu_fw_version_t)) {
		*((uint8_t *)buf + sizeof(nrf_dfu_fw_version_t)) = '\0';
	}

	return 0;
}

int dfusock_firmware_delete(void)
{
	int err;

	err = nrf_setsockopt(dfusock, NRF_SOL_DFU, NRF_SO_DFU_BACKUP_DELETE,
			     NULL, 0);
	if (err) {
		/* Fatal */
		LWM2M_ERR("Failed to delete firmware, errno %d", errno);
		return -errno;
	}

	return 0;
}

int dfusock_firmware_update(void)
{
	int err;

	err = nrf_setsockopt(dfusock, NRF_SOL_DFU, NRF_SO_DFU_APPLY, NULL, 0);
	if (err) {
		/* Fatal */
		LWM2M_ERR("Failed to apply firmware update, errno %d", errno);
		return -errno;
	}

	return 0;
}

int dfusock_firmware_revert(void)
{
	int err;

	err = nrf_setsockopt(dfusock, NRF_SOL_DFU, NRF_SO_DFU_REVERT, NULL, 0);
	if (err) {
		LWM2M_ERR("Failed to rollaback firmware, errno %d", errno);
		return -errno;
	}

	return 0;
}

int dfusock_init(void)
{
	if (dfusock != -1) {
		LWM2M_TRC("Socket already open");
		return 0;
	}

	/* Ready DFU socket */
	dfusock = nrf_socket(NRF_AF_LOCAL, NRF_SOCK_STREAM, NRF_PROTO_DFU);
	if (dfusock < 0) {
		LWM2M_ERR("FATAL: Failed to open DFU socket");
		return -1;
	}

	LWM2M_INF("DFU socket ready");

	return 0;
}
```

## src/dfusock.h
```c
/*
 * Copyright (c) 2019 Nordic Semiconductor ASA
 *
 * SPDX-License-Identifier: LicenseRef-BSD-5-Clause-Nordic
 */

#ifndef DFUSOCK_H__
#define DFUSOCK_H__

#include <stddef.h>
#include <stdint.h>

int dfusock_init(void);
int dfusock_close(void);
int dfusock_offset_get(uint32_t *off);
int dfusock_offset_set(uint32_t off);

/**@brief Retrive the modem firmware version.
 *
 * If the buffer is large enough, additionally NULL-terminates
 * the buffer so that it can be printed.
 */
int dfusock_version_get(uint8_t *buf, size_t len);

int dfusock_fragment_send(const void *buf, size_t len);
int dfusock_firmware_update(void);
int dfusock_firmware_delete(void);

#endif // DFUSOCK_H__
```
